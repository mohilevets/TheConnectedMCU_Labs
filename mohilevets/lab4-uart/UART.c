/* Microchip Technology Inc. and its subsidiaries.  You may use this software 
 * and any derivatives exclusively with Microchip products. 
 * 
 * THIS SOFTWARE IS SUPPLIED BY MICROCHIP "AS IS".  NO WARRANTIES, WHETHER 
 * EXPRESS, IMPLIED OR STATUTORY, APPLY TO THIS SOFTWARE, INCLUDING ANY IMPLIED 
 * WARRANTIES OF NON-INFRINGEMENT, MERCHANTABILITY, AND FITNESS FOR A 
 * PARTICULAR PURPOSE, OR ITS INTERACTION WITH MICROCHIP PRODUCTS, COMBINATION 
 * WITH ANY OTHER PRODUCTS, OR USE IN ANY APPLICATION. 
 *
 * IN NO EVENT WILL MICROCHIP BE LIABLE FOR ANY INDIRECT, SPECIAL, PUNITIVE, 
 * INCIDENTAL OR CONSEQUENTIAL LOSS, DAMAGE, COST OR EXPENSE OF ANY KIND 
 * WHATSOEVER RELATED TO THE SOFTWARE, HOWEVER CAUSED, EVEN IF MICROCHIP HAS 
 * BEEN ADVISED OF THE POSSIBILITY OR THE DAMAGES ARE FORESEEABLE.  TO THE 
 * FULLEST EXTENT ALLOWED BY LAW, MICROCHIP'S TOTAL LIABILITY ON ALL CLAIMS 
 * IN ANY WAY RELATED TO THIS SOFTWARE WILL NOT EXCEED THE AMOUNT OF FEES, IF 
 * ANY, THAT YOU HAVE PAID DIRECTLY TO MICROCHIP FOR THIS SOFTWARE.
 *
 * MICROCHIP PROVIDES THIS SOFTWARE CONDITIONALLY UPON YOUR ACCEPTANCE OF THESE 
 * TERMS. 
 */

/*******************************************************************************
  This source file has NOT been generated by the MHC
 *******************************************************************************/

/* 
 * File:   
 * Author: Based on main.c by Yuri Panchul 
 * Comments: Modified by Alex Dean
 * Revision history: 
 */

// *****************************************************************************
// *****************************************************************************
// Section: Included Files 
// *****************************************************************************
// *****************************************************************************

#include "UART.h"

#define WIDTH 20
#define HEIGHT 20
// *****************************************************************************
// *****************************************************************************
// Section: Global Data Definitions
// *****************************************************************************
// *****************************************************************************



// *****************************************************************************
// *****************************************************************************
// Section: User Functions
// *****************************************************************************
// *****************************************************************************

void UART4_init (void)
{
    RPF8R = 2; // PPS for U4RX from pin F2
    U4RXR = 11; // PPS for U4TX to pin F8
    
    U4STAbits.UTXEN = 1;   // enable transmit pin
    U4STAbits.URXEN = 1;   // enable receive pin
    U4BRG           = ((100 * 1000000) / (16 * 115200)) - 1;
    U4MODEbits.ON   = 1;   // enable UART
}

char UART4_getc(void) {
    while (!U4STAbits.URXDA)
        ; // wait until character received
    return U4RXREG; // read character
}

void UART4_putc (char c)
{
    while (U4STAbits.UTXBF)
        ;  // wait until transmit buffer not full
    U4TXREG = c;  // transmit character
}

/**
 * 
 */
void UART4_puts (char *s)
{
    while (*s != '\0')
        UART4_putc (*s++);
}


// Comment a function definition and leverage automatic documentation 
/**
  <p><b>Function:</b></p>

  <p><b>Summary:</b></p>

  <p><b>Description:</b></p>

  <p><b>Remarks:</b></p>
 */
// TODO Insert function definitions (right here) to leverage live documentation
void UART4_test (void)
{
    char c;
    int i,j,x,y,x_prize,y_prize=0;
    char  a[WIDTH][HEIGHT] =
                {
                    {'1','1','1', '1', '1', '1', '1', '1', '1', '1','1','1','1', '1', '1', '1', '1', '1', '1', '1'},
                    {'1',' ',' ', ' ', ' ', ' ', ' ', '1', ' ', ' ','1',' ',' ', ' ', ' ', ' ', ' ', ' ', ' ', '1'},
                    {'1',' ',' ', '1', ' ', ' ', ' ', '1', ' ', ' ',' ',' ',' ', ' ', ' ', ' ', ' ', ' ', ' ', '1'},
                    {'1',' ','1', '1', ' ', ' ', ' ', '1', ' ', '1',' ','1',' ', ' ', '1', '1', '1', '1', ' ', '1'},
                    {'1',' ',' ', '1', ' ', '1', '1', '1', ' ', '1',' ','1',' ', ' ', '1', ' ', ' ', ' ', ' ', '1'},
                    {'1',' ','1', '1', ' ', ' ', ' ', ' ', ' ', '1',' ','1','1', '1', '1', '1', '1', '1', ' ', '1'},
                    {'1','1',' ', ' ', ' ', ' ', '1', '1', ' ', ' ',' ',' ',' ', ' ', '1', ' ', ' ', '1', ' ', '1'},
                    {'1',' ',' ', ' ', '1', ' ', ' ', ' ', ' ', ' ',' ','1','1', '1', '1', ' ', ' ', '1', ' ', '1'},
                    {'1',' ',' ', ' ', ' ', '1', ' ', '1', '1', ' ',' ',' ',' ', ' ', ' ', ' ', ' ', ' ', ' ', '1'},
                    {'1',' ','1', '1', '1', '1', ' ', '1', ' ', ' ','1','1',' ', ' ', ' ', ' ', ' ', ' ', ' ', '1'},
                    {'1',' ',' ', ' ', ' ', ' ', ' ', ' ', ' ', '1',' ',' ',' ', ' ', ' ', ' ', ' ', ' ', '1', '1'},
                    {'1','1','1', '1', ' ', ' ', ' ', '1', ' ', ' ',' ',' ','1', ' ', '1', '1', '1', ' ', ' ', '1'},
                    {'1','1',' ', ' ', ' ', '1', '1', '1', '1', ' ','1',' ','1', ' ', '1', ' ', ' ', ' ', ' ', '1'},
                    {'1',' ',' ', '1', ' ', '1', ' ', ' ', ' ', ' ','1',' ',' ', '1', ' ', '1', '1', ' ', ' ', '1'},
                    {'1',' ','1', '1', '1', '1', ' ', '1', ' ', ' ','1',' ',' ', ' ', '1', ' ', ' ', '1', '1', '1'},
                    {'1',' ','1', '1', ' ', '1', '1', '1', ' ', ' ','1',' ','1', ' ', '1', ' ', '1', ' ', '1', '1'},
                    {'1',' ',' ', '1', ' ', ' ', '1', ' ', ' ', ' ','1',' ',' ', ' ', ' ', ' ', ' ', ' ', '1', '1'},
                    {'1','1',' ', '1', '1', ' ', ' ', ' ', ' ', ' ','1',' ','1', ' ', '1', ' ', ' ', ' ', ' ', '1'},
                    {'1',' ',' ', '1', ' ', ' ', ' ', '1', ' ', ' ','1',' ','1', ' ', '1', ' ', ' ', ' ', '1', '1'},
                    {'1','1','1', '1', '1', '1', '1', '1', '1', '1','1','1','1', '1', '1', '1', '1', '1', '1', '1'}
                    
                    
                    
                };

    UART4_puts("Hello, World!\r\n");
    UART4_puts("Please press a key.\r\n");
    UART4_puts("w - up, s -down, a - left, d - right.\r\n");
    
    x=1;
    y=1;
    a[x][y]='D';
    
    x_prize=17;
    y_prize=17;
    a[x_prize][y_prize]='X';
    
    
    
    for (;;)
    {
        for (i=0;i<=WIDTH-1; i++){
            for(j=0;j<=HEIGHT-1;j++){
                UART4_putc (a[i][j]);
            }
            UART4_puts("\r\n");
        }
        c = UART4_getc();
        
        switch (c){
            case 'w':
                if ((a[x-1][y]!='1') & (x>0) ){
                    a[x][y]=' ';
                    x=x-1; 
                    a[x][y]='D';
                }
                break;
            case 'a':
                 if ((a[x][y-1]!='1') & (y>0) ){
                    a[x][y]=' ';
                    y=y-1; 
                    a[x][y]='D';
                }
                break;
            case 's':
                 if ((a[x+1][y]!='1') & (x<HEIGHT-1) ){
                    a[x][y]=' ';
                    x=x+1; 
                    a[x][y]='D';
                }
                break;
            case 'd':
                 if ((a[x][y+1]!='1') & (y< WIDTH-1) ){
                    a[x][y]=' ';
                    y=y+1; 
                    a[x][y]='D';
                }
                break;  
            default:
                break;
        }
        
        if ((x==x_prize) & (y==y_prize)) {
            for(i=0; i<4; i++) {
                UART4_puts("VICTORY!!!"); 
            }
        }
        
        UART4_putc('[');
        UART4_putc (c);
        UART4_puts("]\r\n"); 
        UART4_puts("w - up, s -down, a - left, d - right.\r\n");
         //UART4_puts("Hello, World!\r\n");
    //UART4_puts("Please press a key.\r\n");
    }
}
